// SPDX-License-Identifier: GPL-2.0

/dts-v1/;


#include "zynq-coraz7s.dtsi"

//din zynq-7000.dtsi => deja inclus in dispozitiv
&spi0 {
    status = "okay";
    ad5592r_s@0 {
        compatible="ad5592r_s";
		reg = <0>;
		spi-max-frequency = <1000000>;
    };
};


