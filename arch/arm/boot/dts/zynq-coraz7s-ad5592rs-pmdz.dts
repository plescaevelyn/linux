// SPDX-License-Identifier: GPL-2.0
/dts-v1/;

//#include "zynq-coraz7s.dtsi"
#include "zynq-cora7s-axi-pwm-led.dts"

&spi0 {
    status = "okay";
    ad5592rs@0 {
        compatible = "ad5592rs";
        reg = <0>;
        spi-max-frequency = <1000000>;
        spi-cpol;
    };
};
