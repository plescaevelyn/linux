// SPDX-License-Identifier: GPL-2.0
#include "zynq-coraz7s.dtsi"

/ {
	spi@0 {
        status = "okay";

		ad5592r_s@0 {
			compatible = "ad5592r_s";
			reg = <0x0>;
			spi-max-frequency = <1000000>;
		};
	};
};
